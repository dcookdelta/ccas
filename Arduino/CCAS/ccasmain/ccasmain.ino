/*
 * Chicken Coop Automation System (CCAS) 
 * 
 * Main Routine
 * Arduino based controller providing automation to a chicken coop 
 * 
 * Arduino ATMega2560
 * Interrupts = 2 (int0),3 (int1),18 (int5),19 (int4),20 (int3),21 (int2)
 * SPI Ports = MISO 50, MOSI 51, SCK 52, SS for Arduino as Slave is 53
 * I2C Ports = SDA 20, SCL 21 (2560 also has another SDA/SCL port)
 * 
 * DEVICES USED
 * ====================================================================
 * Arduino Mega 2560 R3
 * DS18B20 - Dallas Temperature
 * Nextrox 30RPM 12V DC 37MM High Torque Motor
 * Diymall .96" Yellow Blue i2c/spi 128x64 OLED LCD Module (I2C)
 * JBtek 4 Channel DC 5V Relay Module
 * DS3234 Sparkfun DeadOn RTC Breakout Real-Time Clock  (SPI)
 * DROK L298N Motor Drive Controller Board DC Dual H-Bridge 
 * 
 * Version:     1.0.0 
 * Written By:  David Cook
 * Revision:    May 11 2016
 * 
 * Pin Layout
 * 2 = Manual Coop Door (Int0) pinCoopDoorSwitch
 * 3 = Manual Nest Flap (Int1) pinFlapSwitch
 * 18 = Service Door Switch (Int5) pinServiceDoorSwitch
 * 20 = SDA   I2C (OLED)
 * 21 = SCL   I2C (OLED)
 * 40 = Temperature (OneWire)
 * 41 = Real Time Close SS SPI for pinRTC
 * 50 = MISO  SPI (Real Time Clock)
 * 51 = MOSI  SPI (Real Time Clock)
 * 52 = SCK   SPI (Real Time Clock)
 * 
 */
//Librarys
#include <Wire.h>
#include <SPI.h>
#include <RTClib.h>
#include <Adafruit_SSD1306.h>   //Adafruit SD1306 v1.1.0
#include <Adafruit_GFX.h>       //Adafruit GFX v1.1.5
#include <gfxfont.h>            //Adafruit GFX v1.1.5
#include <OneWire.h>            //OneWire v2.3.2
#include <DallasTemperature.h>  //DallasTemperature v3.7.6
#include <RTClib.h>             //https://github.com/maniacbug/RTClib v4.6
//#include <RTC_DS3234.h>         //https://github.com/maniacbug/RTClib v4.6  Not needed for SPI DS3234, this is for I2C version

//Global Variables
#define OLED_RESET 4
#define CCAS_VERSION String("1.0.0")
#define TEMPERATURE_PRECISION 9

//Pin Usage
const uint8_t pinCoopDoorSwitch = 2;
const uint8_t pinFlapSwitch = 3;
const uint8_t pinServiceDoorSwitch = 18;
const uint8_t pinRTC = 41;
const uint8_t pinOneWireBus = 40;


//Global Objects
Adafruit_SSD1306 oled(OLED_RESET);
OneWire oneWireTemps(pinOneWireBus);
DallasTemperature tempSensors(&oneWireTemps);
DeviceAddress deviceAddress;
uint8_t tempIndoorAddress[8] = {0x28,0x4,0xe1,0xaf,0x7,0x0,0x0,0x9c};
uint8_t tempOutdoorAddress[8] = {0x28,0x2f,0xcc,0xae,0x7,0x0,0x0,0x49};
uint8_t tempWaterAddress[8] = {0x0,0x0,0x0,0x0,0x0,0x0,0x0,0x0};


//General Variables
uint8_t tempWaterLow = 30;
uint8_t tempWaterHigh = 40;
uint8_t tempAirLow = 45;
uint8_t tempAirHigh = 60;
uint8_t tempWater = 0 ;
uint8_t tempIndoor = 0;
uint8_t tempOutdoor = 0;
char systemStatus[10] = "SYSTEM OK";
uint8_t temps[3];


//Volatile Variables RAM versus Register
volatile byte heatingWater = LOW;
volatile byte heatingAir = LOW;


static const unsigned char PROGMEM HippyChickBoot [] = {
0x00, 0x00, 0x00, 0x00, 0x00, 0x00, 0x06, 0x00, 0x00, 0x60, 0x00, 0x00, 0x02, 0x00, 0x00, 0x00,
0x61, 0x98, 0x00, 0x00, 0x00, 0x01, 0xF6, 0x03, 0x00, 0x60, 0x00, 0x00, 0x0F, 0x00, 0x00, 0x00,
0x61, 0x98, 0x00, 0x00, 0x00, 0x03, 0x06, 0x03, 0x00, 0x60, 0x00, 0x00, 0x0D, 0x80, 0x00, 0x00,
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0x00, 0x00, 0x00, 0x00, 0x00, 0x00, 0x00, 0x00, 0xDE, 0x0F, 0x80, 0x00, 0x1C, 0x00, 0x00, 0x00
};

static const unsigned char PROGMEM DisplayScreen [] = {
0x04, 0x00, 0x00, 0x00, 0x00, 0x00, 0x00, 0x00, 0x00, 0x00, 0x00, 0x00, 0x00, 0x00, 0x00, 0x00,
0x0E, 0x00, 0x00, 0x00, 0x00, 0x00, 0x00, 0x00, 0x00, 0x00, 0x00, 0x00, 0x00, 0x00, 0x00, 0x00,
0x09, 0x80, 0x00, 0x00, 0x00, 0x00, 0x00, 0x00, 0x00, 0x00, 0x00, 0x00, 0x00, 0x00, 0x00, 0x00,
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0xFF, 0xFF, 0xFF, 0xFF, 0xFF, 0xFF, 0xFF, 0xFF, 0xFF, 0xFF, 0xFF, 0xFF, 0xFF, 0xFF, 0xFF, 0xFF
};


void displayBoot(){
  /*
   * Display the Hippy Chick Boot Screen and firmware version number
   */
   oled.clearDisplay();
   oled.drawBitmap(0, 0,  HippyChickBoot, 128, 64, WHITE);
   oled.setTextColor(WHITE);
   oled.setTextSize(1);
   oled.setCursor(0,20);
   oled.println("fw " + CCAS_VERSION);
   oled.display();
}


void initRTC(){
  /*
   * Initialize the Real Time Clock library
   */
  SPI.begin();
  SPI.setBitOrder(MSBFIRST);
  SPI.setDataMode(SPI_MODE1);
  digitalWrite(pinRTC,LOW);
  SPI.transfer(0x8E);
  SPI.transfer(0x60);
  digitalWrite(pinRTC,HIGH);
  delay(10);
}

void initOneWireTemps() {
  /*
   * Initialize the OneWire library for the Dallas Temperature sensors
   */
   tempSensors.begin();
   Serial.println("Temperature Sensors Found (" + String(tempSensors.getDeviceCount()) + ")...");
   for (int i=0;i<tempSensors.getDeviceCount();i++){
     Serial.print("  Thermometer Index [" + String(i) + "] Address [");
     tempSensors.getAddress(deviceAddress,i);
     String sAddress = "";
     for (int i=0;i<=7;i++) {
      sAddress.concat(String(deviceAddress[i],HEX));
      if (i<7)  sAddress.concat(":");
     }
     Serial.print(sAddress);
     Serial.print("]  ");
     if (memcmp(deviceAddress,tempIndoorAddress,sizeof(deviceAddress))==0) Serial.print("Indoor Thermometer Found!");
     if (memcmp(deviceAddress,tempOutdoorAddress,sizeof(deviceAddress))==0) Serial.print("Outdoor Thermometer Found!");
     if (memcmp(deviceAddress,tempWaterAddress,sizeof(deviceAddress))==0) Serial.print("Water Thermometer Found!");
     Serial.println();
   }
}

void initSystem(){
  /*
   * Setup Serial Port for debugging
   */
   Serial.begin(9600);
   Serial.println("Initializing System...");
  /*
   * Setup Pin Modes
   */
   Serial.println("   Setting up pins...");
   pinMode(pinCoopDoorSwitch, INPUT);
   pinMode(pinFlapSwitch, INPUT);
   pinMode(pinServiceDoorSwitch, INPUT);
   pinMode(pinRTC,OUTPUT);
  /*
   * Setup Interrupts
   */
   Serial.println("   Setting up Interrupts...");
   noInterrupts();
   attachInterrupt(digitalPinToInterrupt(pinCoopDoorSwitch), switchCoopDoor, RISING);
   attachInterrupt(digitalPinToInterrupt(pinFlapSwitch), switchFlap, RISING);
   attachInterrupt(digitalPinToInterrupt(pinServiceDoorSwitch), switchServiceDoor, CHANGE);
   interrupts();
  /*
   * Initialize Display and show boot screen
   */
   Serial.println("   Setting up Display...");
   oled.begin(SSD1306_SWITCHCAPVCC, 0x3C);
   displayBoot();
   delay(4000);
  /*
   * Initialize Date/Time and set a default 
   */
   Serial.println("   Setting up Real Time Clock...");
   initRTC();
   //setTimeDate(23,5,16,11,40,0); /used to set the time first time
  /*
   * Initialize Dallas Temperature Sensors
   */
   Serial.println("   Setting up Temperature Sensors...");
   initOneWireTemps();
}


void loadConfig(){
  /*
   * 
   */
}


void updateDisplay(){
  /*
   * ToDo:
   * 
   * Outdoor RGB LED Status Light
   * Display Coop Door Open/Closed
   * Display Error Condition
   * Display Indoor Temp
   * Display Outdoor Temp
   * Display Water Temp
   * Display Date & Time
   * Display current Operation (Heating Water, Heating Air, Filling Water, Opening Coop Door, Opening Nest Flap) 
   */
   oled.clearDisplay();
   oled.drawBitmap(0, 0,  DisplayScreen, 128, 64, WHITE);
   oled.setTextColor(WHITE);
   oled.setTextSize(1);

   //Date/Time
   int timeDate[7];
   getDateTime(timeDate);
   String sDate;
   String sTime;
   sDate.concat(timeDate[5]);
   sDate.concat("/");
   sDate.concat(timeDate[4]);
   oled.setCursor(95,0);
   oled.println(sDate);
   sTime.concat(timeDate[2]);
   sTime.concat(":");
   sTime.concat(timeDate[1]);
   //sTime.concat(":");  //if you need seconds to show
   //sTime.concat(timeDate[0]);
   oled.setCursor(95,9);
   oled.println(sTime);

   //Indoor Temp:
   oled.setCursor(30,20);
   oled.println(String(tempIndoor));

   //Outdoor Temp:
   oled.setCursor(110,20);
   oled.println(String(tempOutdoor));

   //Water Temp:
   oled.setCursor(53,30);
   oled.println(String(tempWater));

   //System Status
   oled.setTextSize(2);
   oled.setCursor(2,45);
   oled.println(systemStatus);
   
   //write to the display
   oled.display();
   //Serial.println(readDateTime());  //For Debugging SPI

}


void setTimeDate(int d, int mo, int y, int h, int mi, int s){
  /*
   * Routine to set the date and time on the DS3234 RTC Clock over SPI
   */
   int timeDate [7]={s,mi,h,0,d,mo,y};
   for(int i=0; i<=6;i++) {
    if (i==3) 
      i++;
    int b = timeDate[i]/10;
    int a = timeDate[i]-b*10;
    if (i==2) {
      if (b==2) 
        b=B00000010;
      else if (b==1)
        b=B00000001;
      }
      timeDate[i] = a+(b<<4);
      digitalWrite(pinRTC, LOW);
      SPI.transfer(i+0x80);
      SPI.transfer(timeDate[i]);
      digitalWrite(pinRTC,HIGH);
   }
}


void getDateTime(int timeDate[]){
  /*
   * Function returns Date and Time in a integer array 
   * {0=Sec, 1=Min, 2=Hour, 3=??, 4=Day, 5=Month, 6=Year}
   */
  for(int i=0; i<=6;i++){
    if(i==3)
      i++;
    digitalWrite(pinRTC, LOW);
    SPI.transfer(i+0x00);
    unsigned int n = SPI.transfer(0x00);
    digitalWrite(pinRTC, HIGH);
    int a=n & B00001111;
    if(i==2){
      int b=(n & B00110000)>>4;
      if (b==B00000001)
        b=10;
      timeDate[i]=a+b;
    }
    else if(i==4) {
      int b=(n & B00110000)>>4;
      timeDate[i]=a+b*10;
    }
    else if(i==5) {
      int b=(n & B00010000)>>4;
      timeDate[i]=a+b*10;
    }
    else if(i==6) {
      int b=(n & B11110000)>>4;
      timeDate[i]=a+b*10;
    }
    else {
      int b=(n & B01110000)>>4;
      timeDate[i]=a+b*10;
    }
  }

}


String readDateTime() {
  /*
   * Function gets currentdate and time and returns strong version
   */
   String sDateTime;
   int timeDate[7];
   getDateTime(timeDate);
   sDateTime.concat(timeDate[5]);
   sDateTime.concat("/");
   sDateTime.concat(timeDate[4]);
   sDateTime.concat("/");
   sDateTime.concat(timeDate[6]);
   sDateTime.concat("  ");
   sDateTime.concat(timeDate[2]);
   sDateTime.concat(":");
   sDateTime.concat(timeDate[1]);
   sDateTime.concat(":");
   sDateTime.concat(timeDate[0]);
   return(sDateTime);
}


void readTemps() {
  /*
   * Routine to request temperatures from the Dallas Temperature devices
   */
   tempSensors.requestTemperatures();
   for (int i=0;i<tempSensors.getDeviceCount();i++){
     tempSensors.getAddress(deviceAddress,i);
     if (memcmp(deviceAddress,tempIndoorAddress,sizeof(deviceAddress))==0) {
       if (tempSensors.getTempFByIndex(i) != 185)
       tempIndoor = tempSensors.getTempFByIndex(i);
     }
     if (memcmp(deviceAddress,tempOutdoorAddress,sizeof(deviceAddress))==0) {
       if (tempSensors.getTempFByIndex(i) != 185)
       tempOutdoor = tempSensors.getTempFByIndex(i);
     }
     if (memcmp(deviceAddress,tempWaterAddress,sizeof(deviceAddress))==0) {
       if (tempSensors.getTempFByIndex(i) != 185)
       tempWater = tempSensors.getTempFByIndex(i);
     }
   }   
   
}
  

void switchCoopDoor() {
  /*
   * Code Executes whenever the Manual Coop Door Switch is activated
   * 
   * ToDo:
   * 
   * If the coop door is open, then close the door
   * If the coop doop is closed, then open the door
   * 
   */
   Serial.println("Coop Door Switch CHANGE");
}


void switchFlap() {
  /*
   * Code executes whenever the Nest Flap Door Switch is activated
   * 
   * ToDo:
   * 
   * If the Service Flas is open, then close the flap door
   * If the Service Flap is closed, then open the flap door
   */
}


void switchServiceDoor() {
  /*
   * Code executes whenever the Service Door is open
   * 
   * ToDo:
   * 
   * If pinServiceDoorSwitch is HIGH, then turn on Main LED Light
   * If pinServiceDoorSwitch is LOW, then turn off Main LED Light
   */
   
}


void checkWater() {
  /*
   * Routine to check the water system
   * 
   * ToDo:
   * 
   * Check to see if water level is low
   *  if low sensor is HIGH, then turn on valve, flip fillingWater to ON
   *  if fillingWater is ON and high sensor is HIGH, then turn off valve
   * Check to see if the water is too cold
   *  If water temperature sensor is below tempWaterLow, then turn on water heater, flip heatingWater to HIGH
   *  if heatingWater = HIGH and water temperature sensor is equal to or greater than tempWaterHigh, then turn off water heater, flip heatingWater to LOW
   */
   readTemps();
   Serial.println("Water Temp: " + String(tempWater));
}


void checkAir() {
  /*
   * Routine to check the air in the coop
   * 
   * ToDo:
   * 
   * Check to see if the coop air temperature is ok
   *   if air temperature sensor is below tempAirLow, then turn on heating bulb, flip heatingAir to HIGH
   *   if heatingAir = HIGH and water temperature sensor is equal to or greater than tempAirHigh, then turn off heating bulb, flip heatingAir to LOW
   */
    readTemps();
    Serial.println("Indoor Temp: " + String(tempIndoor));
}

void checkOutdoor(){
  /*
   * Routine to check the air outside the coop
   * 
   * ToDo:
   * Check the outdoor thermometer
   */
   readTemps();
   Serial.println("Outdoor Temp: " + String(tempOutdoor));
}


void setup() {
  /*
   * ToDo:
   * 
   * Intitialize System
   * Load Configuration from Memory
   */

  initSystem();
  loadConfig();

}


void loop() {
  /*
   * ToDo:
   * 
   * Display Control - Loop 
   * Water System - Loop
   * Heat System - Loop
   * Door System - Loop
   * Raspberry Pi Functions
   * Service Door Switch - Interrupt 5
   * Manual Coop Door Switch - Interrupt 0
   * Manual Nest Flap Switch - Interrupt 1
   */

   updateDisplay();
   checkWater();
   checkAir();
   checkOutdoor();
   
}

